## main/Kconfig.projbuild
```kconfig
menu "RuuviTag Gateway Configuration"

    orsource "$IDF_PATH/examples/common_components/env_caps/$IDF_TARGET/Kconfig.env_caps"

    config RUUVI_GW_USE_WIFI
      default y
      bool "Use WiFi"

    if RUUVI_GW_USE_WIFI
      config RUUVI_GW_WIFI_SSID
        string "WiFi SSID"

      config RUUVI_GW_WIFI_PSK
        string "WiFi Password"
    endif # RUUVI_GW_USE_WIFI

    config RUUVI_GW_USE_ETHERNET
      depends on SOC_EMAC_SUPPORTED
      select ETH_USE_ESP32_MAC
      default n
      bool "Internal Ethernet MAC"
      help
          Use internal Ethernet MAC controller.

    if RUUVI_GW_USE_ETHERNET
      config RUUVI_GW_ETH_MDC_GPIO
        int "SMI MDC GPIO number"
        range ENV_GPIO_RANGE_MIN ENV_GPIO_OUT_RANGE_MAX
        default 23
        help
            Set the GPIO number used by SMI MDC.

      config RUUVI_GW_ETH_MDIO_GPIO
        int "SMI MDIO GPIO number"
        range ENV_GPIO_RANGE_MIN ENV_GPIO_OUT_RANGE_MAX
        default 18
        help
            Set the GPIO number used by SMI MDIO.

      config RUUVI_GW_ETH_PHY_RST_GPIO
        int "PHY Reset GPIO number"
        range -1 ENV_GPIO_OUT_RANGE_MAX
        default 5
        help
            Set the GPIO number used to reset PHY chip.
            Set to -1 to disable PHY chip hardware reset.

      config RUUVI_GW_ETH_PHY_ADDR
        int "PHY Address"
        range 0 31
        default 1
        help
            Set PHY address according your board schematic.
    endif # RUUVI_GW_USE_ETHERNET

    config RUUVI_GW_MQTT_CLIENTCERT
      bool "MQTT TLS Client Certificates"
    
    config RUUVI_GW_MQTT_ENDPOINT
      string "MQTT Endpoint"
      help
          MQTT Endpoint, format: mqtts://endpoint:8883
     
    config RUUVI_GW_MQTT_CLIENT_ID
      string "MQTT Client ID"
      default "ruuvi-gw-esp32"
    
    config RUUVI_GW_MQTT_TOPIC
      string "MQTT Topic"

    config RUUVI_GW_MQTT_QOS
      int "MQTT QoS"
      default 0

    config RUUVI_GW_MQTT_RETAIN
      int "MQTT retain flag"
      default 0
    
    config RUUVI_GW_MQTT_TIMEOUT
      int "MQTT Timeout"
      default 30
      help
          MQTT timeout in seconds

    config RUUVI_GW_IGNORE_UNKNOWNTAGS
      bool "Ignore unknown RuuviTags"
      default n
      help
          Ignore unknown RuuviTags not in ethers
    
    config RUUVI_GW_POLLING_INTERVAL
      int "Polling Interval"
      default 2
      help
          Measurement polling interval in minutes
    
    config RUUVI_GW_BLUETOOTH_SCAN_DURATION
      int "Bluetooth Scan Duration"
      default 10
      help
          Bluetooth scan duration in seconds

endmenu
```

## sdkconfig.defaults
```kconfig
CONFIG_BT_ENABLED=y
CONFIG_BTDM_CTRL_MODE_BLE_ONLY=y
CONFIG_BTDM_CTRL_MODE_BR_EDR_ONLY=n
CONFIG_BTDM_CTRL_MODE_BTDM=n
CONFIG_PARTITION_TABLE_SINGLE_APP_LARGE=y
CONFIG_PARTITION_TABLE_FILENAME="partitions_singleapp_large.csv"
CONFIG_COMPILER_OPTIMIZATION_SIZE=y
```
